#include "cygnus.dtsi" // Notice that the main dtsi files are included in the overlay.

&kscan0 {
    col-gpios =
        <&xiao_d 0 (GPIO_ACTIVE_LOW | GPIO_PULL_UP)>,
        <&xiao_d 1 (GPIO_ACTIVE_LOW | GPIO_PULL_UP)>,
        <&xiao_d 2 (GPIO_ACTIVE_LOW | GPIO_PULL_UP)>,
        <&xiao_d 3 (GPIO_ACTIVE_LOW | GPIO_PULL_UP)>,
        <&xiao_d 4 (GPIO_ACTIVE_LOW | GPIO_PULL_UP)>,
        <&xiao_d 5 (GPIO_ACTIVE_LOW | GPIO_PULL_UP)>;
};
